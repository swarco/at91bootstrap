## board/scc-air-v2/scc-air-v2nf_linux_image_dt_defconfig
```kconfig
CONFIG_SCC_AIR_V2=y
CONFIG_RAM_512MB=y
CONFIG_NANDFLASH=y
# CONFIG_PMECC_AUTO_DETECT is not set
CONFIG_CPU_CLK_528MHZ=y
CONFIG_PMECC_CORRECT_BITS_8=y
CONFIG_LOAD_LINUX=y
CONFIG_OVERRIDE_CMDLINE=y
CONFIG_DEBUG=y
```

## board/scc-air-v2/scc-air-v2nf_uboot_defconfig
```kconfig
CONFIG_SCC_AIR_V2=y
CONFIG_CPU_CLK_528MHZ=y
CONFIG_RAM_512MB=y
CONFIG_NANDFLASH=y
CONFIG_ALLOW_NANDFLASH=y
# CONFIG_PMECC_AUTO_DETECT is not set
CONFIG_USE_PMECC=y
CONFIG_PMECC_CORRECT_BITS_8=y
CONFIG_PMECC_SECTOR_SIZE_512=y
CONFIG_LOAD_UBOOT=y
CONFIG_IMG_SIZE="0x000c0000"
CONFIG_IMG_ADDRESS="0x00040000"
CONFIG_JUMP_ADDR="0x26F00000"
CONFIG_DEBUG=y
CONFIG_DEBUG_VERY_LOUD=y
CONFIG_PMECC_HEADER="0xc0304405"
CONFIG_DISABLE_WATCHDOG=y
```
